## firmware/main/Kconfig.projbuild
```kconfig
menu "neko"
    config NEKO_WIFI_SSID
        string "Home Wi-Fi SSID"
        default ""
    config NEKO_WIFI_PASSWORD
        string "Home Wi-Fi password"
        default ""
    config NEKO_WIFI_AWAY_SSID
        string "Away Wi-Fi SSID (your phone's hotspot)"
        default ""
        help
            Used when home isn't in range. Home is preferred whenever it's back.
    config NEKO_WIFI_AWAY_PASSWORD
        string "Away Wi-Fi password"
        default ""
    config NEKO_TAILSCALE_AUTH_KEY
        string "Tailscale auth key (empty = Tailscale off)"
        default ""
        help
            A reusable, pre-approved key from the Tailscale admin (tskey-auth-...).
    config NEKO_TAILSCALE_BOX
        string "The box's tailnet IP (kept connected first)"
        default ""
    config NEKO_TAILSCALE_DERP_REGION
        int "Tailscale home relay region (3 = Singapore)"
        default 3
        help
            Used when a direct connection can't be made. Region numbers: 1 nyc, 3 sin, 4 fra, 7 tok, 8 lhr, 20 hkg.
    config NEKO_WS_URL
        string "Box WebSocket URL"
        default "ws://192.168.1.10:8081/ws"
        help
            The neko server's /ws endpoint on the box's LAN address.
    config NEKO_VOLUME
        int "Speaker volume (0-100)"
        range 0 100
        default 70
    config NEKO_SCREEN_DIM_S
        int "On battery: dim the screen after (seconds without use)"
        default 30
    config NEKO_SLEEP_S
        int "On battery: deep sleep after (seconds without use; a touch wakes it)"
        default 60
endmenu
```
